## Documentation/devicetree/bindings/clock/hisilicon,hi3519-crg.yaml
```yaml
# SPDX-License-Identifier: (GPL-2.0-only OR BSD-2-Clause)
%YAML 1.2
---
$id: http://devicetree.org/schemas/clock/hisilicon,hi3519-crg.yaml#
$schema: http://devicetree.org/meta-schemas/core.yaml#

title: HiSilicon HI3519/HI3798CV200 Clock and Reset Generator (CRG)

maintainers:
  - Wei Xu <xuwei5@hisilicon.com>

description:
  The CRG module provides clock and reset signals to various modules within the
  SoC.

properties:
  compatible:
    oneOf:
      - items:
          - const: hisilicon,hi3798cv200-crg
          - const: syscon
          - const: simple-mfd
      - items:
          - const: hisilicon,hi3798cv200-sysctrl
          - const: syscon
      - items:
          - const: hisilicon,hi3519-crg

  reg:
    maxItems: 1

  '#clock-cells':
    description: >
      The identifiers for the cells can be found in:

        dt-bindings/clock/hi3519-clock.h
        dt-bindings/clock/histb-clock.h
    const: 1

  '#reset-cells':
    description:
      A reset signal can be controlled by writing a bit register in the CRG
      module. The reset specifier consists of two cells. The first cell
      represents the register offset relative to the base address. The second
      cell represents the bit index in the register.
    const: 2

  reset-controller:
    type: object
    properties:
      compatible:
        const: ti,syscon-reset

    additionalProperties: true

required:
  - compatible
  - reg
  - '#clock-cells'
  - '#reset-cells'

additionalProperties: false
```

## Documentation/devicetree/bindings/clock/xlnx,ps7-clkc.yaml
```yaml
# SPDX-License-Identifier: GPL-2.0-only OR BSD-2-Clause
%YAML 1.2
---
$id: http://devicetree.org/schemas/clock/xlnx,ps7-clkc.yaml#
$schema: http://devicetree.org/meta-schemas/core.yaml#

title: Xilinx Zynq 7000 clock controller

maintainers:
  - Michal Simek <michal.simek@amd.com>

description:
  The clock controller generates the PS clocks from the three PLLs and the
  clock generators in the System Level Control Registers (SLCR). It is a
  child node of the SLCR. See Chapter 25 of the Zynq TRM (UG585) for more
  information about Zynq clocks.

properties:
  compatible:
    const: xlnx,ps7-clkc

  reg:
    maxItems: 1

  "#clock-cells":
    const: 1

  clocks:
    minItems: 1
    maxItems: 58

  clock-names:
    minItems: 1
    maxItems: 58
    description:
      Optional (E)MIO clock sources. mio_clk_XX names the EMIO clock on MIO
      pin XX and may be given for pins 00 to 53.
    items:
      oneOf:
        - enum: [ gem0_emio_clk, gem1_emio_clk, swdt_ext_clk, trace_emio_clk ]
        - pattern: '^mio_clk_([0-4][0-9]|5[0-3])$'

  clock-output-names:
    description:
      Names for the 48 clock outputs, in the order the single clock cell
      indexes them.
    items:
      - const: armpll
      - const: ddrpll
      - const: iopll
      - const: cpu_6or4x
      - const: cpu_3or2x
      - const: cpu_2x
      - const: cpu_1x
      - const: ddr2x
      - const: ddr3x
      - const: dci
      - const: lqspi
      - const: smc
      - const: pcap
      - const: gem0
      - const: gem1
      - const: fclk0
      - const: fclk1
      - const: fclk2
      - const: fclk3
      - const: can0
      - const: can1
      - const: sdio0
      - const: sdio1
      - const: uart0
      - const: uart1
      - const: spi0
      - const: spi1
      - const: dma
      - const: usb0_aper
      - const: usb1_aper
      - const: gem0_aper
      - const: gem1_aper
      - const: sdio0_aper
      - const: sdio1_aper
      - const: spi0_aper
      - const: spi1_aper
      - const: can0_aper
      - const: can1_aper
      - const: i2c0_aper
      - const: i2c1_aper
      - const: uart0_aper
      - const: uart1_aper
      - const: gpio_aper
      - const: lqspi_aper
      - const: smc_aper
      - const: swdt
      - const: dbg_trc
      - const: dbg_apb

  ps-clk-frequency:
    $ref: /schemas/types.yaml#/definitions/uint32
    default: 33333333
    description:
      Frequency of the oscillator providing ps_clk, in Hz. Zynq platforms
      usually fit a 33 MHz oscillator.

  fclk-enable:
    $ref: /schemas/types.yaml#/definitions/uint32
    default: 0
    maximum: 0xf
    description:
      Bit mask of FCLKs to enable at boot time. Bits 0 to 3 correspond to
      FCLK0 to FCLK3.

required:
  - compatible
  - reg
  - "#clock-cells"
  - clock-output-names

additionalProperties: false

examples:
  - |
    clkc: clock-controller@100 {
        compatible = "xlnx,ps7-clkc";
        reg = <0x100 0x100>;
        #clock-cells = <1>;
        ps-clk-frequency = <33333333>;
        fclk-enable = <0>;
        clock-output-names = "armpll", "ddrpll", "iopll", "cpu_6or4x",
                             "cpu_3or2x", "cpu_2x", "cpu_1x", "ddr2x",
                             "ddr3x", "dci", "lqspi", "smc", "pcap",
                             "gem0", "gem1", "fclk0", "fclk1", "fclk2",
                             "fclk3", "can0", "can1", "sdio0", "sdio1",
                             "uart0", "uart1", "spi0", "spi1", "dma",
                             "usb0_aper", "usb1_aper", "gem0_aper",
                             "gem1_aper", "sdio0_aper", "sdio1_aper",
                             "spi0_aper", "spi1_aper", "can0_aper",
                             "can1_aper", "i2c0_aper", "i2c1_aper",
                             "uart0_aper", "uart1_aper", "gpio_aper",
                             "lqspi_aper", "smc_aper", "swdt", "dbg_trc",
                             "dbg_apb";
        clocks = <&clkc 16>, <&clk_foo>;
        clock-names = "gem1_emio_clk", "mio_clk_23";
    };

...
```

## Documentation/devicetree/bindings/reset/xlnx,zynq-reset.yaml
```yaml
# SPDX-License-Identifier: GPL-2.0-only OR BSD-2-Clause
%YAML 1.2
---
$id: http://devicetree.org/schemas/reset/xlnx,zynq-reset.yaml#
$schema: http://devicetree.org/meta-schemas/core.yaml#

title: Xilinx Zynq Reset Manager

maintainers:
  - Michal Simek <michal.simek@amd.com>

description:
  The Zynq AP-SoC has several different resets, driven from registers in the
  System Level Control Registers (SLCR). The reset manager is a child node of
  the SLCR. See Chapter 26 of the Zynq TRM (UG585) for more information about
  Zynq resets.

properties:
  compatible:
    const: xlnx,zynq-reset

  reg:
    maxItems: 1
    description:
      Offset and length of the reset registers within the SLCR.

  syscon:
    $ref: /schemas/types.yaml#/definitions/phandle
    description: phandle to the SLCR registers

  "#reset-cells":
    const: 1
    description: |
      The single cell indexes the reset within the register block at 32
      resets per register, so it is the register's position in the block
      times 32 plus the bit number within that register:

        0   soft
        32  ddr
        64  topsw
        96  dmac
        128 usb0
        129 usb1
        160 gem0
        161 gem1
        164 gem0 rx
        165 gem1 rx
        166 gem0 ref
        167 gem1 ref
        192 sdio0
        193 sdio1
        196 sdio0 ref
        197 sdio1 ref
        224 spi0
        225 spi1
        226 spi0 ref
        227 spi1 ref
        256 can0
        257 can1
        258 can0 ref
        259 can1 ref
        288 i2c0
        289 i2c1
        320 uart0
        321 uart1
        322 uart0 ref
        323 uart1 ref
        352 gpio
        384 lqspi
        385 qspi ref
        416 smc
        417 smc ref
        448 ocm
        512 fpga0 out
        513 fpga1 out
        514 fpga2 out
        515 fpga3 out
        544 a9 reset 0
        545 a9 reset 1
        552 peri

required:
  - compatible
  - reg
  - syscon
  - "#reset-cells"

additionalProperties: false

examples:
  - |
    reset-controller@200 {
        compatible = "xlnx,zynq-reset";
        reg = <0x200 0x48>;
        #reset-cells = <1>;
        syscon = <&slcr>;
    };

...
```

## drivers/base/regmap/Kconfig
```kconfig
# SPDX-License-Identifier: GPL-2.0
# Generic register map support.  There are no user servicable options here,
# this is an API intended to be used by other kernel subsystems.  These
# subsystems should select the appropriate symbols.

config REGMAP
	bool

config REGMAP_KUNIT
	tristate "KUnit tests for regmap"
	depends on KUNIT && REGMAP
	default KUNIT_ALL_TESTS
	select REGMAP_RAM

config REGMAP_BUILD
	bool "Enable regmap build"
	depends on KUNIT
	select REGMAP
	help
	  This option exists purely to allow the regmap KUnit tests to
	  be enabled without having to enable some driver that uses
	  regmap due to unfortunate issues with how KUnit tests are
	  normally enabled.

config REGMAP_AC97
	tristate
	imply REGMAP

config REGMAP_I2C
	tristate
	depends on I2C
	imply REGMAP

config REGMAP_SLIMBUS
	tristate
	depends on SLIMBUS
	imply REGMAP

config REGMAP_SPI
	tristate
	depends on SPI
	imply REGMAP

config REGMAP_SPMI
	tristate
	depends on SPMI
	imply REGMAP

config REGMAP_W1
	tristate
	depends on W1
	imply REGMAP

config REGMAP_MDIO
	tristate
	depends on PHYLIB
	imply REGMAP

config REGMAP_MMIO
	tristate
	imply REGMAP

config REGMAP_IRQ
	bool
	select IRQ_DOMAIN
	imply REGMAP

config REGMAP_RAM
	tristate

config REGMAP_SOUNDWIRE
	tristate
	depends on SOUNDWIRE
	imply REGMAP

config REGMAP_SOUNDWIRE_MBQ
	tristate
	depends on SOUNDWIRE
	imply REGMAP

config REGMAP_SCCB
	tristate
	depends on I2C
	imply REGMAP

config REGMAP_I3C
	tristate
	depends on I3C
	imply REGMAP

config REGMAP_SPI_AVMM
	tristate
	depends on SPI
	imply REGMAP

config REGMAP_FSI
	tristate
	depends on FSI
	imply REGMAP
```
